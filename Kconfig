## Kconfig
```kconfig
if SAMPLE_SUPPORT_WILD_LINK_SERVER

config APP_INIT_TASK_STACK_SIZE
    int
    prompt "Config the app init task stack size"
    default 256
    help
        Config the app init task stack size.

config APP_INIT_TASK_PRIORITY
    int
    prompt "Config the app init task stack size"
    range 0 31
    default 14
    help
        Config the app init task stack size.

menu "Soft I2C Configuration"
config SOFT_I2C_SCL_PIN
    int
    prompt "Select the soft i2c scl pin"
    range 0 16
    default 0

config SOFT_I2C_SDA_PIN
    int
    prompt "Select the soft i2c sda pin"
    range 0 16
    default 2
config SOFT_I2C_SUPPORT_CONCURRENCY
    bool "soft i2c support concurrency"
    default y
endmenu

menu "Sle Configuration"
    osource "application/samples/demo/wild_link_server/Kconfig.sle"
endmenu # Sle Configuration

menu "Drivers Configuration"
    osource "application/samples/demo/wild_link_server/Kconfig.drivers"
endmenu # "Drivers Configuration"

menu "Task Configuration"
    osource "application/samples/demo/wild_link_server/Kconfig.tasks"
endmenu # Task Configuration

endif # SAMPLE_SUPPORT_WILD_LINK_SERVER
```

## Kconfig.drivers
```kconfig
config MAX30102_DRIVER_ENABLED
    bool "Enable MAX30102 Driver"
    default y

if MAX30102_DRIVER_ENABLED
menu "MAX30102 Configuration"
    config MAX30102_I2C_BUS_ID
    int "MAX30102 I2C Bus ID"
    range 1 1
    default 1

    config MAX30102_INT_PIN
    int "MAX30102 INT PIN"
    range 0 31
    default 10
endmenu # "MAX30102 Configuration"
endif # MAX30102_DRIVER_ENABLED

config MAX30205_DRIVER_ENABLED
    bool "Enable max30205 Driver"
    default y
```

## Kconfig.sle
```kconfig
config SLE_SERVER_APP_UUID
    hex "Sle app uuid"
    default 0x1234

config SLE_SERVER_SERVICE_UUID
    hex "Sle service uuid"
    default 0x2222

config SLE_SERVER_MAX30102_UUID
    hex "MAX30102 property uuid"
    default 0x2323

config SLE_SERVER_MAX30205_UUID
    hex "MAX30205 property uuid"
    default 0x2324

config SLE_SERVER_ADDR_LOW_BYTE
    hex "Sle server addr low byte"
    range 0x00 0xff
    default 0x01
```

## Kconfig.tasks
```kconfig
if MAX30102_DRIVER_ENABLED

config MAX30102_TASK_ENABLED
    bool "Enable MAX30102 Task"
    default y

menu "MAX30102 Task"
depends on MAX30102_TASK_ENABLED

config MAX30102_TASK_STACK_SIZE
    int
    prompt "Config the max30102 task stack size"
    default 512
    help
        Config the max30102 task stack size.

config MAX30102_TASK_PRIORITY
    int
    prompt "Config the max30102 task priority"
    range 0 31
    default 16
    help
        Config the max30102 task priority.
endmenu # "MAX30102 Task"

endif # MAX30102_DRIVER_ENABLED

if MAX30205_DRIVER_ENABLED

config MAX30205_TASK_ENABLED
    bool "Enable MAX30205 Task"
    default y

menu "MAX30205 Task"
depends on MAX30205_TASK_ENABLED

config MAX30205_TASK_STACK_SIZE
    int
    prompt "Config the max30205 task stack size"
    default 512
    help
        Config the max30205 task stack size.

config MAX30205_TASK_PRIORITY
    int
    prompt "Config the max30205 task priority"
    range 0 31
    default 16
    help
        Config the max30205 task priority.
endmenu # "MAX30205 Task"

endif # MAX30205_DRIVER_ENABLED

menu "SLE Server Task"
config SLE_SERVER_TASK_STACK_SIZE
    int
    prompt "Config the sle server task stack size"
    default 512
    help
        Config the sle server task stack size.

config SLE_SERVER_TASK_PRIORITY
    int
    prompt "Config the sle server task priority"
    range 0 31
    default 15
    help
        Config the sle server task priority.
endmenu # SLE Server Task
```
